## modules/battery_rgb/Kconfig
```kconfig
config ZMK_BATTERY_RGB_BLINK
    bool "Periodic battery level RGB indicator"
    depends on ZMK_RGB_UNDERGLOW && ZMK_BATTERY_REPORTING
    help
      Shows 3 RGB blinks periodically to indicate battery level.
      Green (>60%), Orange (20-60%), Red (<=20%).
      Each split half operates independently with its own battery.

if ZMK_BATTERY_RGB_BLINK

config ZMK_BATTERY_RGB_PERIOD_MS
    int "Indicator period (ms)"
    default 60000
    help
      How often to show the battery indicator. Default: 60000 (1 minute).
      Set lower (e.g. 10000) to test without waiting a full minute.

endif
```
